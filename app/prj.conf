## Kconfig
```
mainmenu "WebUSB Broadcast Assistant"

config WEBUSB_TX_MSG_QUEUE_SIZE
	int "The number of elements in the WebUSB Transmit Message Queue"
	default 4

config WEBUSB_APPLICATION_TX_MAX_PAYLOAD_SIZE
	int "The maximum size of the payload being received by and transmitted by the application"
	default 1024

source "Kconfig.zephyr"
```

## prj.conf
```kconfig
# Bluetooth & Settings
CONFIG_BT=y
CONFIG_BT_CENTRAL=y
CONFIG_BT_AUDIO=y
CONFIG_BT_SMP=y
CONFIG_BT_BONDABLE=n
CONFIG_BT_BUF_ACL_RX_SIZE=255
CONFIG_BT_BUF_ACL_TX_SIZE=251
CONFIG_BT_CTLR_SCAN_DATA_LEN_MAX=191
CONFIG_BT_TINYCRYPT_ECC=y
CONFIG_BT_EXT_ADV=y
CONFIG_BT_BAP_BROADCAST_ASSISTANT=y

# CONFIG_BT_BAP_SCAN_DELEGATOR=y is required until the following
# bug is fixed: https://github.com/zephyrproject-rtos/zephyr/issues/68338
CONFIG_BT_BAP_SCAN_DELEGATOR=y


# USB Device Settings
CONFIG_USB_DEVICE_STACK=y
CONFIG_USB_DEVICE_BOS=y
# CONFIG_SERIAL=y
CONFIG_USB_DEVICE_PRODUCT="WebUSB Broadcast Assistant"
CONFIG_USB_DEVICE_PID=0x000A
# CONFIG_UART_INTERRUPT_DRIVEN=y
# CONFIG_UART_LINE_CTRL=y
CONFIG_USB_DEVICE_INITIALIZE_AT_BOOT=n
CONFIG_RING_BUFFER=y
CONFIG_PRINTK=y

# Shell & Logging

CONFIG_LOG=y
# CONFIG_USB_DRIVER_LOG_LEVEL_ERR=y

CONFIG_BT_RX_STACK_SIZE=4096
CONFIG_SYSTEM_WORKQUEUE_STACK_SIZE=4096

CONFIG_BT_BAP_BROADCAST_ASSISTANT_LOG_LEVEL_DBG=y
```

## src/main.c
```c
/*
 * SPDX-License-Identifier: Apache-2.0
 */

/**
 * @file
 * @brief Sample app for a WebUSB Broadcast Assistant
 */

#include <zephyr/usb/usb_device.h>

#include "webusb.h"
#include "msosv2.h"
#include "broadcast_assistant.h"
#include "message_handler.h"

LOG_MODULE_REGISTER(main, LOG_LEVEL_INF);

int main(void)
{
	int ret;

	LOG_INF("web-broadcast-assistants starting");

	/* Initialize WebUSB component */
	msosv2_init();
	webusb_init();

	/* Set the message handler */
	webusb_register_message_handler(&message_handler);
	message_handler_init();

	ret = usb_enable(NULL);
	if (ret != 0) {
		LOG_ERR("Failed to enable USB");
		return ret;
	}

	/* Bluetooth initialization */
	ret = broadcast_assistant_init();
	if (ret != 0) {
		LOG_ERR("Failed to initialise broadcast assistant");
		return ret;
	}

	return 0;
}
```

## src/broadcast_assistant.h
```c
/*
 * SPDX-License-Identifier: Apache-2.0
 */

/**
 * @file
 * @brief
 *
 */

#ifndef __BROADCAST_ASSISTANT_H__
#define __BROADCAST_ASSISTANT_H__

#include <zephyr/types.h>
#include <zephyr/bluetooth/gap.h>
#include <zephyr/bluetooth/addr.h>

#define BT_DATA_RSSI         (BT_DATA_MANUFACTURER_DATA - 1)
#define BT_DATA_SID          (BT_DATA_MANUFACTURER_DATA - 2)
#define BT_DATA_PA_INTERVAL  (BT_DATA_MANUFACTURER_DATA - 3)
#define BT_DATA_ERROR_CODE   (BT_DATA_MANUFACTURER_DATA - 4)
#define BT_DATA_BROADCAST_ID (BT_DATA_MANUFACTURER_DATA - 5)
#define BT_DATA_RPA          (BT_DATA_MANUFACTURER_DATA - 6)
#define BT_DATA_IDENTITY     (BT_DATA_MANUFACTURER_DATA - 7)

enum {
	BROADCAST_ASSISTANT_SCAN_TARGET_SOURCE = BIT(0),
	BROADCAST_ASSISTANT_SCAN_TARGET_SINK = BIT(1),
	BROADCAST_ASSISTANT_SCAN_TARGET_ALL =
		(BROADCAST_ASSISTANT_SCAN_TARGET_SOURCE | BROADCAST_ASSISTANT_SCAN_TARGET_SINK)
};

int start_scan(uint8_t target);
int stop_scanning(void);
int connect_to_sink(bt_addr_le_t *bt_addr_le);
int disconnect_from_sink(bt_addr_le_t *bt_addr_le);
int add_source(uint8_t sid, uint16_t pa_interval, uint32_t broadcast_id, bt_addr_le_t *addr);
int remove_source(void);
int broadcast_assistant_init(void);
int disconnect_unpair_all(void);

#endif /* __BROADCAST_ASSISTANT_H__ */
```

## src/command.c
```c
/*
 * SPDX-License-Identifier: Apache-2.0
 */

/**
 * @file
 * @brief
 *
 */

#include <zephyr/types.h>
#include <zephyr/logging/log.h>
#include <zephyr/kernel.h>

#include "webusb.h"
#include "broadcast_assistant.h"
#include "command.h"

LOG_MODULE_REGISTER(command, LOG_LEVEL_DBG);


#define HEARTBEAT_ON 1


static void heartbeat_timeout_handler(struct k_timer *dummy_p);
K_TIMER_DEFINE(heartbeat_timer, heartbeat_timeout_handler, NULL);


static void heartbeat_timeout_handler(struct k_timer *timer)
{
	// Assemble heartbeat event and send
	uint8_t payload[] = { 'H', 'E', 'A', 'R', 'T'};

	if (webusb_transmit((uint8_t*)&payload, sizeof(payload)) != 0) {
		LOG_ERR("FAILED TO SEND ");
	}
}

void send_ok_response(void) {
	// Assemble OK response and send
	uint8_t payload[] = { 'O', 'K'};
	if (webusb_transmit((uint8_t*)&payload, sizeof(payload)) != 0) {
		LOG_ERR("FAILED TO SEND ");
	}
}

void send_dummy_response(uint8_t seq_no) {
	int ret;
	// Assemble Dummy response and send (payload size = 0)
	uint8_t buf[] = {
		MESSAGE_TYPE_RES,
		MESSAGE_SUBTYPE_DUMMY,
		seq_no,
		0,0
	};
	ret = webusb_transmit((uint8_t*)&buf, sizeof(buf));
	if (ret != 0) {
		LOG_ERR("FAILED TO SEND Dummy response (err=%d)", ret);
	}
}

void send_response(enum message_sub_type type, uint8_t seq_no)
{
	/* For now, just send ACK
	 * TODO: Send Error back if it failed
	 */
	int ret;
	// Assemble Dummy response and send (payload size = 0)
	uint8_t buf[] = {
		MESSAGE_TYPE_RES,
		type,
		seq_no,
		0,0
	};
	ret = webusb_transmit((uint8_t*)&buf, sizeof(buf));
	if (ret != 0) {
		LOG_ERR("FAILED TO SEND response (err=%d)", ret);
	}
}

void send_error_response(void) {
	// Assemble OK response and send
	uint8_t payload[] = { 'E', 'R', 'R'};
	if (webusb_transmit((uint8_t*)&payload, sizeof(payload)) != 0) {
		LOG_ERR("FAILED TO SEND ");
	}
}

void command_handler(struct command_message *command_ptr, uint16_t command_length)
{
	// MISSING PARSING OF COMMANDS AND DEFINITIONS OF THOSE !!!!
	//uint8_t msg_type = command_ptr->type;
	uint8_t msg_sub_type = command_ptr->sub_type;
	uint8_t msg_seq_no = command_ptr->seq_no;

	switch (msg_sub_type) {
	case MESSAGE_SUBTYPE_HEARTBEAT:
		if (HEARTBEAT_ON) {
			// Start generating heartbeats every second
			k_timer_start(&heartbeat_timer, K_SECONDS(1), K_SECONDS(1));
		} else {
			// Stop heartbeat timer if running
			k_timer_stop(&heartbeat_timer);
		}
		send_ok_response();
		break;

	case MESSAGE_SUBTYPE_DUMMY:
		LOG_DBG("DUMMY CMD received... send response...");
		send_dummy_response(msg_seq_no);
		break;

	case MESSAGE_SUBTYPE_START_SINK_SCAN:
		LOG_DBG("MESSAGE_SUBTYPE_START_SINK_SCAN");
		scan_for_broadcast_sink(msg_seq_no);
		break;

	case MESSAGE_SUBTYPE_START_SOURCE_SCAN:
		LOG_DBG("MESSAGE_SUBTYPE_START_SOURCE_SCAN");
		scan_for_broadcast_source(msg_seq_no);
		break;

	case MESSAGE_SUBTYPE_STOP_SCAN:
		LOG_DBG("MESSAGE_SUBTYPE_STOP_SCAN");
		stop_scanning(msg_seq_no);
		break;

	default:
		// Unrecognized command
		send_error_response();
		break;
	}
}

void command_init(void) {
	k_timer_init(&heartbeat_timer, heartbeat_timeout_handler, NULL);
}
```

## src/command.h
```c
/*
 * SPDX-License-Identifier: Apache-2.0
 */

/**
 * @file
 * @brief
 *
 */

#ifndef __COMMAND_H__
#define __COMMAND_H__

#include <zephyr/types.h>

#define MAX_MSG_PAYLOAD_LEN 1024

enum message_type {
	MESSAGE_TYPE_CMD = 1,
	MESSAGE_TYPE_RES,
	MESSAGE_TYPE_EVT,
};

enum message_sub_type {
	/* CMD/RES (bit7 = 0) */
	MESSAGE_SUBTYPE_START_SINK_SCAN   = 0x01,
	MESSAGE_SUBTYPE_START_SOURCE_SCAN = 0x02,
	MESSAGE_SUBTYPE_STOP_SCAN         = 0x03,

	MESSAGE_SUBTYPE_DUMMY             = 0x7F,

	/* EVT (bit7 = 1) */
	MESSAGE_SUBTYPE_SINK_FOUND        = 0x81,
	MESSAGE_SUBTYPE_SOURCE_FOUND      = 0x82,

	MESSAGE_SUBTYPE_HEARTBEAT         = 0xFF,
};

struct command_message {
	uint8_t type;
	uint8_t sub_type;
	uint8_t seq_no;
	uint16_t length;
	uint8_t payload[MAX_MSG_PAYLOAD_LEN];
} __packed;

void send_ok_response(void);
void send_dummy_response(uint8_t seq_no);
void send_response(enum message_sub_type type, uint8_t seq_no);
void send_error_response(void);
void command_handler(struct command_message *command_ptr, uint16_t command_length);
void command_init(void);

#endif /* __COMMAND_H__ */
```

## src/message_handler.c
```c
/*
 * SPDX-License-Identifier: Apache-2.0
 */

/**
 * @file
 * @brief
 *
 */

#include <zephyr/types.h>
#include <zephyr/logging/log.h>
#include <zephyr/kernel.h>
#include <zephyr/sys/byteorder.h>
#include <zephyr/net/buf.h>
#include <zephyr/bluetooth/bluetooth.h>

#include "webusb.h"
#include "broadcast_assistant.h"
#include "message_handler.h"

LOG_MODULE_REGISTER(message_handler, LOG_LEVEL_INF);

NET_BUF_POOL_DEFINE(command_tx_msg_pool, CONFIG_TX_MSG_MAX_MESSAGES, sizeof(struct webusb_message) + CONFIG_TX_MSG_MAX_PAYLOAD_LEN, 0, NULL);

struct webusb_ltv_data {
	uint8_t adv_sid;
	uint16_t pa_interval;
	uint32_t broadcast_id;
	bt_addr_le_t addr;
} __packed;


static void heartbeat_timeout_handler(struct k_timer *dummy_p);
K_TIMER_DEFINE(heartbeat_timer, heartbeat_timeout_handler, NULL);

static void log_ltv(uint8_t *data, uint16_t data_len);

#define LTV_STR_LEN 256

static void log_ltv(uint8_t *data, uint16_t data_len)
{
	char ltv_str[LTV_STR_LEN] = {0};

	/* Log message payload (ltv format) */
	for (int i = 0; i < data_len;) {
		uint8_t ltv_len = *data++;
		char *ch_ptr = &ltv_str[0];

		/* length */
		sprintf(ch_ptr, "[ L:%02x ", ltv_len);
		ch_ptr += 7;
		if (ltv_len > 0) {
			/* type */
			sprintf(ch_ptr, "T:%02x ", *data++);
			ch_ptr += 5;
			if (ltv_len > 1) {
				/* value */
				for (int j = 1; j < ltv_len; j++) {
					sprintf(ch_ptr, "%02x ", *data++);
					ch_ptr += 3;
				}
			}
		}
		sprintf(ch_ptr, "]");
		ch_ptr += 1;
		i += (ltv_len + 1);

		LOG_DBG("%s", ltv_str);
	}
}

static struct webusb_ltv_data parsed_ltv_data;
static void heartbeat_timeout_handler(struct k_timer *timer)
{
	static uint8_t heartbeat_cnt = 0;
	struct net_buf *tx_net_buf;
	int ret;

	tx_net_buf = net_buf_alloc(&command_tx_msg_pool, K_FOREVER);
	if (!tx_net_buf) {
		return;
	}

	net_buf_push_le16(tx_net_buf, 0);
	net_buf_push_u8(tx_net_buf, heartbeat_cnt++);
	net_buf_push_u8(tx_net_buf, MESSAGE_SUBTYPE_HEARTBEAT);
	net_buf_push_u8(tx_net_buf, MESSAGE_TYPE_EVT);

	ret = webusb_transmit(tx_net_buf);
	if (ret != 0) {
		LOG_ERR("Failed to send response (err=%d)", ret);
	}
}

struct net_buf* message_alloc_tx_message(void)
{
	struct net_buf *tx_net_buf;

	tx_net_buf = net_buf_alloc(&command_tx_msg_pool, K_NO_WAIT);
	if (!tx_net_buf) {
		return NULL;
	}

	// Reserve headroom for the webusb msg header
	net_buf_reserve(tx_net_buf, sizeof(struct webusb_message));

	return tx_net_buf;
}

static void send_simple_message(enum message_type mtype, enum message_sub_type stype, uint8_t seq_no, int32_t rc)
{
	struct net_buf *tx_net_buf;
	uint16_t msg_payload_length;
	int ret;

	LOG_INF("send simple message(%d, %d, %u, %d)", mtype, stype, seq_no, rc);


	tx_net_buf = message_alloc_tx_message();
	if (!tx_net_buf) {
		LOG_ERR("Failed to allocate net_buf");
	}

	/* Append error code payload */
	net_buf_add_u8(tx_net_buf, 5);
	net_buf_add_u8(tx_net_buf, BT_DATA_ERROR_CODE);
	net_buf_add_le32(tx_net_buf, rc);
	msg_payload_length = tx_net_buf->len;

	// Prepend message header
	net_buf_push_le16(tx_net_buf, msg_payload_length);
	net_buf_push_u8(tx_net_buf, seq_no);
	net_buf_push_u8(tx_net_buf, stype);
	net_buf_push_u8(tx_net_buf, mtype);

	log_ltv(&tx_net_buf->data[0], tx_net_buf->len);

	ret = webusb_transmit(tx_net_buf);
	if (ret != 0) {
		LOG_ERR("Failed to send message (err=%d)", ret);
	}

}

void send_response(enum message_sub_type stype, uint8_t seq_no, int32_t rc)
{
	send_simple_message(MESSAGE_TYPE_RES, stype, seq_no, rc);
}

void send_event(enum message_sub_type stype, int32_t rc)
{
	send_simple_message(MESSAGE_TYPE_EVT, stype, 0, rc);
}

void send_net_buf_event(enum message_sub_type stype, struct net_buf *tx_net_buf)
{
	int ret;

	// Prepend message header
	net_buf_push_le16(tx_net_buf, tx_net_buf->len);
	net_buf_push_u8(tx_net_buf, 0);
	net_buf_push_u8(tx_net_buf, stype);
	net_buf_push_u8(tx_net_buf, MESSAGE_TYPE_EVT);

	LOG_INF("send_net_buf_event(stype: %d)", stype);
	log_ltv(&tx_net_buf->data[0], tx_net_buf->len);

	ret = webusb_transmit(tx_net_buf);
	if (ret != 0) {
		LOG_ERR("Failed to send message (err=%d)", ret);
	}
}

bool ltv_found(struct bt_data *data, void *user_data)
{
	struct webusb_ltv_data *_parsed = (struct webusb_ltv_data *)user_data;

	LOG_DBG("Found LTV structure with type %u", data->type);

	switch (data->type) {
	case BT_DATA_SID:
		LOG_DBG("BT_DATA_SID");
		_parsed->adv_sid = data->data[0];
		return true;
	case BT_DATA_PA_INTERVAL:
		_parsed->pa_interval = sys_get_le16(data->data);
		LOG_DBG("BT_DATA_PA_INTERVAL");
		return true;
	case BT_DATA_BROADCAST_ID:
		_parsed->broadcast_id = sys_get_le24(data->data);
		LOG_DBG("BT_DATA_BROADCAST_ID");
		return true;
	case BT_DATA_RPA:
	case BT_DATA_IDENTITY:
		char addr_str[BT_ADDR_LE_STR_LEN];
		_parsed->addr.type = data->data[0];
		memcpy(&_parsed->addr.a, &data->data[1], sizeof(bt_addr_t));
		bt_addr_le_to_str(&_parsed->addr, addr_str, sizeof(addr_str));
		LOG_DBG("Addr: %s", addr_str);
		return true;
	default:
		LOG_DBG("Unknown type");
	}

	return false;
}

void message_handler(struct webusb_message *msg_ptr, uint16_t msg_length)
{
	if (msg_ptr == NULL) {
		LOG_ERR("Null msg_ptr");
		return;
	}

	/*uint8_t msg_type = msg_ptr->type;*/
	uint8_t msg_sub_type = msg_ptr->sub_type;
	uint8_t msg_seq_no = msg_ptr->seq_no;
	int32_t msg_rc = 0;
	struct net_buf_simple msg_net_buf;

	msg_net_buf.data = msg_ptr->payload;
	msg_net_buf.len = msg_ptr->length;
	msg_net_buf.size = CONFIG_TX_MSG_MAX_PAYLOAD_LEN;
	msg_net_buf.__buf = msg_ptr->payload;

	bt_data_parse(&msg_net_buf, ltv_found, (void *)&parsed_ltv_data);

	switch (msg_sub_type) {
	case MESSAGE_SUBTYPE_HEARTBEAT:
			static bool heartbeat_on = false;
			if (!heartbeat_on) {
			// Start generating heartbeats every second
				heartbeat_on = true;
			k_timer_start(&heartbeat_timer, K_SECONDS(1), K_SECONDS(1));
		} else {
				heartbeat_on = false;
			// Stop heartbeat timer if running
			k_timer_stop(&heartbeat_timer);
		}
		send_response(MESSAGE_SUBTYPE_HEARTBEAT, msg_seq_no, 0);
		break;

	case MESSAGE_SUBTYPE_START_SINK_SCAN:
		LOG_DBG("MESSAGE_SUBTYPE_START_SINK_SCAN");
		msg_rc = start_scan(BROADCAST_ASSISTANT_SCAN_TARGET_SINK);
		send_response(MESSAGE_SUBTYPE_START_SINK_SCAN, msg_seq_no, msg_rc);
		break;

	case MESSAGE_SUBTYPE_START_SOURCE_SCAN:
		LOG_DBG("MESSAGE_SUBTYPE_START_SOURCE_SCAN");
		msg_rc = start_scan(BROADCAST_ASSISTANT_SCAN_TARGET_SOURCE);
		send_response(MESSAGE_SUBTYPE_START_SOURCE_SCAN, msg_seq_no, msg_rc);
		break;

	case MESSAGE_SUBTYPE_START_SCAN_ALL:
		LOG_DBG("MESSAGE_SUBTYPE_START_SCAN_ALL");
		msg_rc = start_scan(BROADCAST_ASSISTANT_SCAN_TARGET_ALL);
		send_response(MESSAGE_SUBTYPE_START_SCAN_ALL, msg_seq_no, msg_rc);
		break;

	case MESSAGE_SUBTYPE_STOP_SCAN:
		LOG_DBG("MESSAGE_SUBTYPE_STOP_SCAN");
		msg_rc = stop_scanning();
		send_response(MESSAGE_SUBTYPE_STOP_SCAN, msg_seq_no, msg_rc);
		break;

	case MESSAGE_SUBTYPE_CONNECT_SINK:
		LOG_DBG("MESSAGE_SUBTYPE_CONNECT_SINK (len %u)", msg_length);
		msg_rc = connect_to_sink(&parsed_ltv_data.addr);
		send_response(MESSAGE_SUBTYPE_CONNECT_SINK, msg_seq_no, msg_rc);
		break;

	case MESSAGE_SUBTYPE_DISCONNECT_SINK:
		LOG_DBG("MESSAGE_SUBTYPE_DISCONNECT_SINK (len %u)", msg_length);
		msg_rc = disconnect_from_sink(&parsed_ltv_data.addr);
		send_response(MESSAGE_SUBTYPE_DISCONNECT_SINK, msg_seq_no, msg_rc);
		break;

	case MESSAGE_SUBTYPE_ADD_SOURCE:
		LOG_DBG("MESSAGE_SUBTYPE_ADD_SOURCE (len %u)", msg_length);
		msg_rc = add_source(parsed_ltv_data.adv_sid, parsed_ltv_data.pa_interval,
				    parsed_ltv_data.broadcast_id, &parsed_ltv_data.addr);
		send_response(MESSAGE_SUBTYPE_ADD_SOURCE, msg_seq_no, msg_rc);
		break;

	case MESSAGE_SUBTYPE_REMOVE_SOURCE:
		LOG_DBG("MESSAGE_SUBTYPE_REMOVE_SOURCE (len %u)", msg_length);
		msg_rc = remove_source();
		send_response(MESSAGE_SUBTYPE_REMOVE_SOURCE, msg_seq_no, msg_rc);
		break;

	case MESSAGE_SUBTYPE_RESET:
		LOG_DBG("MESSAGE_SUBTYPE_RESET (len %u)", msg_length);
		msg_rc = stop_scanning();
		send_response(MESSAGE_SUBTYPE_STOP_SCAN, msg_seq_no, msg_rc);
		msg_rc = disconnect_unpair_all();
		send_response(MESSAGE_SUBTYPE_RESET, msg_seq_no, msg_rc);
		// Stop heartbeat if active
		heartbeat_on = false;
		k_timer_stop(&heartbeat_timer);
		break;

	default:
		// Unrecognized message
		send_response(msg_sub_type, msg_seq_no, -1);
		break;
	}
}

void message_handler_init(void)
{
	k_timer_init(&heartbeat_timer, heartbeat_timeout_handler, NULL);
}
```

## src/message_handler.h
```c
/*
 * SPDX-License-Identifier: Apache-2.0
 */

/**
 * @file
 * @brief
 *
 */

#ifndef __COMMAND_H__
#define __COMMAND_H__

#include <zephyr/types.h>

enum message_type {
	MESSAGE_TYPE_CMD = 1,
	MESSAGE_TYPE_RES,
	MESSAGE_TYPE_EVT,
};

enum message_sub_type {
	/* CMD/RES (bit7 = 0) */
	MESSAGE_SUBTYPE_START_SINK_SCAN         = 0x01,
	MESSAGE_SUBTYPE_START_SOURCE_SCAN       = 0x02,
	MESSAGE_SUBTYPE_START_SCAN_ALL    	= 0x03,
	MESSAGE_SUBTYPE_STOP_SCAN               = 0x04,
	MESSAGE_SUBTYPE_CONNECT_SINK            = 0x05,
	MESSAGE_SUBTYPE_DISCONNECT_SINK         = 0x06,
	MESSAGE_SUBTYPE_ADD_SOURCE              = 0x07,
	MESSAGE_SUBTYPE_REMOVE_SOURCE           = 0x08,
	MESSAGE_SUBTYPE_RESET                   = 0x2A,

	/* EVT (bit7 = 1) */
	MESSAGE_SUBTYPE_SINK_FOUND              = 0x81,
	MESSAGE_SUBTYPE_SOURCE_FOUND            = 0x82,
	MESSAGE_SUBTYPE_SINK_CONNECTED          = 0x83,
	MESSAGE_SUBTYPE_SINK_DISCONNECTED       = 0x84,
	MESSAGE_SUBTYPE_SOURCE_ADDED            = 0x85,
	MESSAGE_SUBTYPE_SOURCE_REMOVED          = 0x86,
	MESSAGE_SUBTYPE_NEW_PA_STATE_NOT_SYNCED = 0x87,
	MESSAGE_SUBTYPE_NEW_PA_STATE_INFO_REQ   = 0x88,
	MESSAGE_SUBTYPE_NEW_PA_STATE_SYNCED     = 0x89,
	MESSAGE_SUBTYPE_NEW_PA_STATE_FAILED     = 0x8A,
	MESSAGE_SUBTYPE_NEW_PA_STATE_NO_PAST    = 0x8B,
	MESSAGE_SUBTYPE_BIS_SYNCED              = 0x8C,
	MESSAGE_SUBTYPE_BIS_NOT_SYNCED          = 0x8D,
	MESSAGE_SUBTYPE_IDENTITY_RESOLVED	= 0x8E,

	MESSAGE_SUBTYPE_HEARTBEAT               = 0xFF,
};

struct webusb_message {
	uint8_t type;
	uint8_t sub_type;
	uint8_t seq_no;
	uint16_t length;
	uint8_t payload[];
} __packed;

struct net_buf* message_alloc_tx_message(void);
void send_response(enum message_sub_type stype, uint8_t seq_no, int32_t rc);
void send_event(enum message_sub_type stype, int32_t rc);
void send_net_buf_event(enum message_sub_type stype, struct net_buf *tx_net_buf);
void message_handler(struct webusb_message *msg_ptr, uint16_t msg_length);
void message_handler_init(void);

#endif /* __COMMAND_H__ */
```

## src/msosv2.c
```c
/*
 * SPDX-License-Identifier: Apache-2.0
 */

#include <zephyr/logging/log.h>
#include <zephyr/sys/byteorder.h>
#include <zephyr/usb/usb_device.h>
#include <zephyr/usb/bos.h>
#include <zephyr/usb/msos_desc.h>

#include "msosv2.h"

LOG_MODULE_REGISTER(msosv2, LOG_LEVEL_ERR);


/* random GUID {FA611CC3-7057-42EE-9D82-4919639562B3} */
#define WEBUSB_DEVICE_INTERFACE_GUID \
	'{', 0x00, 'F', 0x00, 'A', 0x00, '6', 0x00, '1', 0x00, '1', 0x00, \
	'C', 0x00, 'C', 0x00, '3', 0x00, '-', 0x00, '7', 0x00, '0', 0x00, \
	'5', 0x00, '7', 0x00, '-', 0x00, '4', 0x00, '2', 0x00, 'E', 0x00, \
	'E', 0x00, '-', 0x00, '9', 0x00, 'D', 0x00, '8', 0x00, '2', 0x00, \
	'-', 0x00, '4', 0x00, '9', 0x00, '1', 0x00, '9', 0x00, '6', 0x00, \
	'3', 0x00, '9', 0x00, '5', 0x00, '6', 0x00, '2', 0x00, 'B', 0x00, \
	'3', 0x00, '}', 0x00, 0x00, 0x00, 0x00, 0x00

#define COMPATIBLE_ID_WINUSB \
	'W', 'I', 'N', 'U', 'S', 'B', 0x00, 0x00

static struct msosv2_descriptor_t {
	struct msosv2_descriptor_set_header header;
#if defined(CONFIG_USB_CDC_ACM)
	struct msosv2_function_subset_header subset_header;
#endif
	struct msosv2_compatible_id webusb_compatible_id;
	struct msosv2_guids_property webusb_guids_property;
} __packed msosv2_descriptor = {
	/* Microsoft OS 2.0 descriptor set
	 * This tells Windows what kind of device this is and to install the WinUSB driver.
	 */
	.header = {
		.wLength = sizeof(struct msosv2_descriptor_set_header),
		.wDescriptorType = MS_OS_20_SET_HEADER_DESCRIPTOR,
		.dwWindowsVersion = 0x06030000,
		.wTotalLength = sizeof(struct msosv2_descriptor_t),
	},
#if defined(CONFIG_USB_CDC_ACM)
	/* If CONFIG_USB_CDC_ACM is selected, extra interfaces will be added on build time,
	 * making the target a composite device, which requires an extra Function
	 * Subset Header.
	 */
	.subset_header = {
		.wLength = sizeof(struct msosv2_function_subset_header),
		.wDescriptorType = MS_OS_20_SUBSET_HEADER_FUNCTION,
		/* The WebUSB interface number becomes the first when CDC_ACM is enabled by
		 * configuration.  Beware that if this sample is used as as inspiration for
		 * applications, where the WebUSB interface is no longer the first,
		 * remember to adjust bFirstInterface.
		 */
		.bFirstInterface = 0,
		.wSubsetLength = 160
	},
#endif
	.webusb_compatible_id = {
		.wLength = sizeof(struct msosv2_compatible_id),
		.wDescriptorType = MS_OS_20_FEATURE_COMPATIBLE_ID,
		.CompatibleID = {COMPATIBLE_ID_WINUSB},
	},
	.webusb_guids_property = {
		.wLength = sizeof(struct msosv2_guids_property),
		.wDescriptorType = MS_OS_20_FEATURE_REG_PROPERTY,
		.wPropertyDataType = MS_OS_20_PROPERTY_DATA_REG_MULTI_SZ,
		.wPropertyNameLength = 42,
		.PropertyName = {DEVICE_INTERFACE_GUIDS_PROPERTY_NAME},
		.wPropertyDataLength = 80,
		.bPropertyData = {WEBUSB_DEVICE_INTERFACE_GUID},
	},
};

USB_DEVICE_BOS_DESC_DEFINE_CAP struct usb_bos_webusb_desc {
	struct usb_bos_platform_descriptor platform;
	struct usb_bos_capability_webusb cap;
} __packed bos_cap_webusb = {
	/* WebUSB Platform Capability Descriptor:
	 * https://wicg.github.io/webusb/#webusb-platform-capability-descriptor
	 */
	.platform = {
		.bLength = sizeof(struct usb_bos_platform_descriptor)
			+ sizeof(struct usb_bos_capability_webusb),
		.bDescriptorType = USB_DESC_DEVICE_CAPABILITY,
		.bDevCapabilityType = USB_BOS_CAPABILITY_PLATFORM,
		.bReserved = 0,
		/* WebUSB Platform Capability UUID
		 * 3408b638-09a9-47a0-8bfd-a0768815b665
		 */
		.PlatformCapabilityUUID = {
			0x38, 0xB6, 0x08, 0x34,
			0xA9, 0x09,
			0xA0, 0x47,
			0x8B, 0xFD,
			0xA0, 0x76, 0x88, 0x15, 0xB6, 0x65,
		},
	},
	.cap = {
		.bcdVersion = sys_cpu_to_le16(0x0100),
		.bVendorCode = 0x01,
		.iLandingPage = 0x01
	}
};

USB_DEVICE_BOS_DESC_DEFINE_CAP struct usb_bos_msosv2_desc {
	struct usb_bos_platform_descriptor platform;
	struct usb_bos_capability_msos cap;
} __packed bos_cap_msosv2 = {
	/* Microsoft OS 2.0 Platform Capability Descriptor
	 * See https://docs.microsoft.com/en-us/windows-hardware/drivers/usbcon/
	 * microsoft-defined-usb-descriptors
	 * Adapted from the source:
	 * https://github.com/sowbug/weblight/blob/master/firmware/webusb.c
	 * (BSD-2) Thanks http://janaxelson.com/files/ms_os_20_descriptors.c
	 */
	.platform = {
		.bLength = sizeof(struct usb_bos_platform_descriptor)
			+ sizeof(struct usb_bos_capability_msos),
		.bDescriptorType = USB_DESC_DEVICE_CAPABILITY,
		.bDevCapabilityType = USB_BOS_CAPABILITY_PLATFORM,
		.bReserved = 0,
		.PlatformCapabilityUUID = {
			/**
			 * MS OS 2.0 Platform Capability ID
			 * D8DD60DF-4589-4CC7-9CD2-659D9E648A9F
			 */
			0xDF, 0x60, 0xDD, 0xD8,
			0x89, 0x45,
			0xC7, 0x4C,
			0x9C, 0xD2,
			0x65, 0x9D, 0x9E, 0x64, 0x8A, 0x9F,
		},
	},
	.cap = {
		/* Windows version (8.1) (0x06030000) */
		.dwWindowsVersion = sys_cpu_to_le32(0x06030000),
		.wMSOSDescriptorSetTotalLength =
			sys_cpu_to_le16(sizeof(msosv2_descriptor)),
		/* Arbitrary code that is used as bRequest for vendor command */
		.bMS_VendorCode = 0x02,
		.bAltEnumCode = 0x00
	},
};

USB_DEVICE_BOS_DESC_DEFINE_CAP struct usb_bos_capability_lpm bos_cap_lpm = {
	.bLength = sizeof(struct usb_bos_capability_lpm),
	.bDescriptorType = USB_DESC_DEVICE_CAPABILITY,
	.bDevCapabilityType = USB_BOS_CAPABILITY_EXTENSION,
	/**
	 * BIT(1) - LPM support
	 * BIT(2) - BESL support
	 */
	.bmAttributes = BIT(1) | BIT(2),
};

/* WebUSB Device Requests */
static const uint8_t webusb_allowed_origins[] = {
	/* Allowed Origins Header:
	 * https://wicg.github.io/webusb/#get-allowed-origins
	 */
	0x05, 0x00, 0x0D, 0x00, 0x01,

	/* Configuration Subset Header:
	 * https://wicg.github.io/webusb/#configuration-subset-header
	 */
	0x04, 0x01, 0x01, 0x01,

	/* Function Subset Header:
	 * https://wicg.github.io/webusb/#function-subset-header
	 */
	0x04, 0x02, 0x02, 0x01
};

/* Number of allowed origins */
#define NUMBER_OF_ALLOWED_ORIGINS   1

/* URL Descriptor: https://wicg.github.io/webusb/#url-descriptor */
static const uint8_t webusb_origin_url[] = {
	/* Length, DescriptorType, Scheme */
	0x11, 0x03, 0x00,
	'l', 'o', 'c', 'a', 'l', 'h', 'o', 's', 't', ':', '8', '0', '0', '0'
};

/* Predefined response to control commands related to MS OS 1.0 descriptors
 * Please note that this code only defines "extended compat ID OS feature
 * descriptors" and not "extended properties OS features descriptors"
 */
#define MSOS_STRING_LENGTH	18
static struct string_desc {
	uint8_t bLength;
	uint8_t bDescriptorType;
	uint8_t bString[MSOS_STRING_LENGTH];

} __packed msos1_string_descriptor = {
	.bLength = MSOS_STRING_LENGTH,
	.bDescriptorType = USB_DESC_STRING,
	/* Signature MSFT100 */
	.bString = {
		'M', 0x00, 'S', 0x00, 'F', 0x00, 'T', 0x00,
		'1', 0x00, '0', 0x00, '0', 0x00,
		0x03, /* Vendor Code, used for a control request */
		0x00, /* Padding byte for VendorCode looks like UTF16 */
	},
};

static const uint8_t msos1_compatid_descriptor[] = {
	/* See https://github.com/pbatard/libwdi/wiki/WCID-Devices */
	/* MS OS 1.0 header section */
	0x28, 0x00, 0x00, 0x00, /* Descriptor size (40 bytes)          */
	0x00, 0x01,             /* Version 1.00                        */
	0x04, 0x00,             /* Type: Extended compat ID descriptor */
	0x01,                   /* Number of function sections         */
	0x00, 0x00, 0x00, 0x00, 0x00, 0x00, 0x00,       /* reserved    */

	/* MS OS 1.0 function section */
	0x02,     /* Index of interface this section applies to. */
	0x01,     /* reserved */
	/* 8-byte compatible ID string, then 8-byte sub-compatible ID string */
	'W',  'I',  'N',  'U',  'S',  'B',  0x00, 0x00,
	0x00, 0x00, 0x00, 0x00, 0x00, 0x00, 0x00, 0x00,
	0x00, 0x00, 0x00, 0x00, 0x00, 0x00 /* reserved */
};

/**
 * @brief Custom handler for standard requests in
 *        order to catch the request and return the
 *        WebUSB Platform Capability Descriptor.
 *
 * @param pSetup    Information about the request to execute.
 * @param len       Size of the buffer.
 * @param data      Buffer containing the request result.
 *
 * @return  0 on success, negative errno code on fail
 */
int msosv2_custom_handle_req(struct usb_setup_packet *pSetup,
		      int32_t *len, uint8_t **data)
{
	if (usb_reqtype_is_to_device(pSetup)) {
		return -ENOTSUP;
	}

	if (USB_GET_DESCRIPTOR_TYPE(pSetup->wValue) == USB_DESC_STRING &&
	    USB_GET_DESCRIPTOR_INDEX(pSetup->wValue) == 0xEE) {
		*data = (uint8_t *)(&msos1_string_descriptor);
		*len = sizeof(msos1_string_descriptor);

		LOG_DBG("Get MS OS Descriptor v1 string");

		return 0;
	}

	return -EINVAL;
}

/**
 * @brief Handler called for vendor specific commands. This includes
 *        WebUSB allowed origins and MS OS 1.0 and 2.0 descriptors.
 *
 * @param pSetup    Information about the request to execute.
 * @param len       Size of the buffer.
 * @param data      Buffer containing the request result.
 *
 * @return  0 on success, negative errno code on fail.
 */
int msosv2_vendor_handle_req(struct usb_setup_packet *pSetup,
		      int32_t *len, uint8_t **data)
{
	if (usb_reqtype_is_to_device(pSetup)) {
		return -ENOTSUP;
	}

	/* Get Allowed origins request */
	if (pSetup->bRequest == 0x01 && pSetup->wIndex == 0x01) {
		*data = (uint8_t *)(&webusb_allowed_origins);
		*len = sizeof(webusb_allowed_origins);

		LOG_DBG("Get webusb_allowed_origins");

		return 0;
	} else if (pSetup->bRequest == 0x01 && pSetup->wIndex == 0x02) {
		/* Get URL request */
		uint8_t index = USB_GET_DESCRIPTOR_INDEX(pSetup->wValue);

		if (index == 0U || index > NUMBER_OF_ALLOWED_ORIGINS) {
			return -ENOTSUP;
		}

		*data = (uint8_t *)(&webusb_origin_url);
		*len = sizeof(webusb_origin_url);

		LOG_DBG("Get webusb_origin_url");

		return 0;
	} else if (pSetup->bRequest == bos_cap_msosv2.cap.bMS_VendorCode &&
		   pSetup->wIndex == MS_OS_20_DESCRIPTOR_INDEX) {
		/* Get MS OS 2.0 Descriptors request */
		*data = (uint8_t *)(&msosv2_descriptor);
		*len = sizeof(msosv2_descriptor);

		LOG_DBG("Get MS OS Descriptors v2");

		return 0;
	} else if (pSetup->bRequest == 0x03 && pSetup->wIndex == 0x04) {
		/* Get MS OS 1.0 Descriptors request */
		/* 0x04 means "Extended compat ID".
		 * Use 0x05 instead for "Extended properties".
		 */
		*data = (uint8_t *)(&msos1_compatid_descriptor);
		*len = sizeof(msos1_compatid_descriptor);

		LOG_DBG("Get MS OS Descriptors CompatibleID");

		return 0;
	}

	return -ENOTSUP;
}

void msosv2_init(void)
{
	usb_bos_register_cap((void *)&bos_cap_webusb);
	usb_bos_register_cap((void *)&bos_cap_msosv2);
	usb_bos_register_cap((void *)&bos_cap_lpm);
}
```

## src/msosv2.h
```c
/*
 * SPDX-License-Identifier: Apache-2.0
 */

#include <zephyr/sys/byteorder.h>
#include <zephyr/usb/usb_device.h>
#include <zephyr/usb/bos.h>
#include <zephyr/usb/msos_desc.h>

#include "webusb.h"


int msosv2_custom_handle_req(struct usb_setup_packet *pSetup, int32_t *len, uint8_t **data);

int msosv2_vendor_handle_req(struct usb_setup_packet *pSetup, int32_t *len, uint8_t **data);

void msosv2_init(void);
```

## src/webusb.c
```c
/*
 * SPDX-License-Identifier: Apache-2.0
 */

/**
 * @file
 * @brief WebUSB enabled custom class driver
 *
 * This is a modified version of CDC ACM class driver
 * to support the WebUSB.
 */

#include <zephyr/logging/log.h>
LOG_MODULE_REGISTER(webusb, LOG_LEVEL_ERR);


#include <zephyr/kernel.h>
#include <zephyr/sys/byteorder.h>
#include <zephyr/sys/ring_buffer.h>
#include <zephyr/usb/usb_device.h>
#include <usb_descriptor.h>

#include "message_handler.h"
#include "webusb.h"
#include "cobs.h"
#include "msosv2.h"

/* Max packet size for Bulk endpoints */
#if defined(CONFIG_USB_DC_HAS_HS_SUPPORT)
#define WEBUSB_BULK_EP_MPS		512
#else
#define WEBUSB_BULK_EP_MPS		64
#endif

/* Number of interfaces */
#define WEBUSB_NUM_ITF			0x01
/* Number of Endpoints in the custom interface */
#define WEBUSB_NUM_EP			0x02

#define WEBUSB_IN_EP_IDX		0
#define WEBUSB_OUT_EP_IDX		1

#define WEBUSB_WORKQUEUE_STACK_SIZE 2048
#define WEBUSB_WORKQUEUE_PRIORITY K_PRIO_PREEMPT(1)

void (*webusb_msg_handler)(struct webusb_message *msg_ptr, uint16_t msg_length);

#define MAX_COBS_MESSAGE_SIZE COBS_ENCODE_DST_BUF_LEN_MAX(CONFIG_TX_MSG_MAX_PAYLOAD_LEN)

uint8_t rx_buf[MAX_COBS_MESSAGE_SIZE];

#define INITIALIZER_IF(num_ep, iface_class)				\
	{								\
		.bLength = sizeof(struct usb_if_descriptor),		\
		.bDescriptorType = USB_DESC_INTERFACE,			\
		.bInterfaceNumber = 0,					\
		.bAlternateSetting = 0,					\
		.bNumEndpoints = num_ep,				\
		.bInterfaceClass = iface_class,				\
		.bInterfaceSubClass = 0,				\
		.bInterfaceProtocol = 0,				\
		.iInterface = 0,					\
	}

#define INITIALIZER_IF_EP(addr, attr, mps, interval)			\
	{								\
		.bLength = sizeof(struct usb_ep_descriptor),		\
		.bDescriptorType = USB_DESC_ENDPOINT,			\
		.bEndpointAddress = addr,				\
		.bmAttributes = attr,					\
		.wMaxPacketSize = sys_cpu_to_le16(mps),			\
		.bInterval = interval,					\
	}

USBD_CLASS_DESCR_DEFINE(primary, 0) struct {
	struct usb_if_descriptor if0;
	struct usb_ep_descriptor if0_in_ep;
	struct usb_ep_descriptor if0_out_ep;
} __packed webusb_desc = {
	.if0 = INITIALIZER_IF(WEBUSB_NUM_EP, USB_BCC_VENDOR),
	.if0_in_ep = INITIALIZER_IF_EP(AUTO_EP_IN, USB_DC_EP_BULK,
				       WEBUSB_BULK_EP_MPS, 0),
	.if0_out_ep = INITIALIZER_IF_EP(AUTO_EP_OUT, USB_DC_EP_BULK,
					WEBUSB_BULK_EP_MPS, 0),
};

/* Describe EndPoints configuration */
static struct usb_ep_cfg_data webusb_ep_data[] = {
	{
		.ep_cb = usb_transfer_ep_callback,
		.ep_addr = AUTO_EP_IN
	},
	{
		.ep_cb	= usb_transfer_ep_callback,
		.ep_addr = AUTO_EP_OUT
	}
};

struct k_work_q webusb_workqueue;
K_THREAD_STACK_DEFINE(webusb_workqueue_stack, WEBUSB_WORKQUEUE_STACK_SIZE);

static void webusb_rx_work_handler(struct k_work *work_p);
K_WORK_DEFINE(webusb_rx_work, webusb_rx_work_handler);
static void webusb_tx_work_handler(struct k_work *work_p);
K_WORK_DEFINE(webusb_tx_work, webusb_tx_work_handler);
K_MSGQ_DEFINE(webusb_tx_msg_queue, sizeof(struct net_buf*), CONFIG_TX_MSG_MAX_MESSAGES, 4);

uint8_t cobs_decoded_stream[MAX_COBS_MESSAGE_SIZE];
uint16_t cobs_decoded_length;
uint8_t cobs_encoded_stream[MAX_COBS_MESSAGE_SIZE];

/*#define WEBUSB_DEBUG*/

#ifdef WEBUSB_DEBUG
static void print_hex(const uint8_t *ptr, size_t len)
{
	while (len-- != 0) {
		printk("%02x ", *ptr++);
	}
	printk("\n");
}
#endif /* WEBUSB_DEBUG */

void webusb_init(void)
{
	k_work_init(&webusb_rx_work, webusb_rx_work_handler);
	k_work_init(&webusb_tx_work, webusb_tx_work_handler);

	k_work_queue_start(&webusb_workqueue,
	                   webusb_workqueue_stack,
	                   K_THREAD_STACK_SIZEOF(webusb_workqueue_stack),
	                   WEBUSB_WORKQUEUE_PRIORITY,
	                   NULL);
	k_thread_name_set(&webusb_workqueue.thread, "webusbworker");
}

int webusb_transmit(struct net_buf *tx_net_buf)
{
	int ret;

	LOG_DBG("Preparing to send message (size=%d)", tx_net_buf->len);
#ifdef WEBUSB_DEBUG
	print_hex(tx_net_buf->data, tx_net_buf->len);
#endif /* WEBUSB_DEBUG */
	if (tx_net_buf->len > sizeof(struct webusb_message) + CONFIG_TX_MSG_MAX_PAYLOAD_LEN) {
		return -EINVAL;
	}

	LOG_DBG("Trying to put message on queue");

	ret = k_msgq_put(&webusb_tx_msg_queue, &tx_net_buf, K_NO_WAIT);

	if (ret != 0) {
		LOG_ERR("Failed to put message on queue");
		return ret;
	}
	ret = k_work_submit_to_queue(&webusb_workqueue, &webusb_tx_work);
	if (ret < 0) {
		LOG_ERR("Failed to submit work qo workqueue");
		return ret;
	}
	return 0;
}

static void webusb_rx_work_handler(struct k_work *work_p)
{
	ARG_UNUSED(work_p);

	if (webusb_msg_handler) {
		webusb_msg_handler((struct webusb_message *)&cobs_decoded_stream, cobs_decoded_length);
	}
}

static void webusb_tx_work_handler(struct k_work *work_p)
{
	ARG_UNUSED(work_p);

	struct net_buf *tx_net_buf = NULL;

	while (k_msgq_get(&webusb_tx_msg_queue, &tx_net_buf, K_NO_WAIT) == 0) {
		cobs_encode_result result;

		// Leave room for a terminating zero byte.
		result = cobs_encode(&cobs_encoded_stream, sizeof(cobs_encoded_stream)-1, tx_net_buf->data, tx_net_buf->len);
		if (result.status != COBS_ENCODE_OK) {
			LOG_ERR("COBS Encoding failed: %d", result.status);
		}
		cobs_encoded_stream[result.out_len++] = '\0';

		net_buf_unref(tx_net_buf);

		// We will never send more than WEBUSB_BULK_EP_MPS so we should
		// be able to do it as a sync transfer and not handle callbacks.
		usb_transfer_sync(webusb_ep_data[WEBUSB_IN_EP_IDX].ep_addr, cobs_encoded_stream,
		                  result.out_len, USB_TRANS_WRITE);
	}
}

/**
 * @brief Register Command Handler callback
 *
 * This function registers a Command Handler for handling the
 * device requests.
 *
 * @param [in] handlers Pointer to WebUSB command handler structure
 */
void webusb_register_message_handler(void (*cb)(struct webusb_message *msg_ptr,
						uint16_t msg_length))
{
	webusb_msg_handler = cb;
}

static void webusb_read_cb(uint8_t ep, int size, void *priv)
{
	struct usb_cfg_data *cfg = priv;
	cobs_decode_result result;

	LOG_DBG("cfg %p ep %x size %u", cfg, ep, size);

	if ((size <= 0)) {
		// Skip empty packages
		goto done;
	}

	result = cobs_decode(&cobs_decoded_stream, sizeof(cobs_decoded_stream), rx_buf, strlen(rx_buf));
	if (result.status == COBS_DECODE_OK) {
		cobs_decoded_length = result.out_len;
		LOG_DBG("Decoded COBS to Message, len=%d", result.out_len);
#ifdef WEBUSB_DEBUG
		print_hex(cobs_decoded_stream, result.out_len);
#endif /* WEBUSB_DEBUG */
		k_work_submit_to_queue(&webusb_workqueue, &webusb_rx_work);
	} else {
		LOG_ERR("Could not decode received COBS encoded data! - err: %d", result.status);
	}

done:
	usb_transfer(ep, rx_buf, sizeof(rx_buf), USB_TRANS_READ, webusb_read_cb, cfg);
}

/**
 * @brief Callback used to know the USB connection status
 *
 * @param status USB device status code.
 */
static void webusb_dev_status_cb(struct usb_cfg_data *cfg,
				 enum usb_dc_status_code status,
				 const uint8_t *param)
{
	ARG_UNUSED(param);
	ARG_UNUSED(cfg);

	/* Check the USB status and do needed action if required */
	switch (status) {
	case USB_DC_ERROR:
		LOG_DBG("USB device error");
		break;
	case USB_DC_RESET:
		LOG_DBG("USB device reset detected");
		break;
	case USB_DC_CONNECTED:
		LOG_DBG("USB device connected");
		break;
	case USB_DC_CONFIGURED:
		LOG_DBG("USB device configured");
		webusb_read_cb(cfg->endpoint[WEBUSB_OUT_EP_IDX].ep_addr,
			       0, cfg);
		break;
	case USB_DC_DISCONNECTED:
		LOG_DBG("USB device disconnected");
		break;
	case USB_DC_SUSPEND:
		LOG_DBG("USB device suspended");
		break;
	case USB_DC_RESUME:
		LOG_DBG("USB device resumed");
		break;
	case USB_DC_UNKNOWN:
	default:
		LOG_DBG("USB unknown state");
		break;
	}
}

USBD_DEFINE_CFG_DATA(webusb_config) = {
	.usb_device_description = NULL,
	.interface_descriptor = &webusb_desc.if0,
	.cb_usb_status = webusb_dev_status_cb,
	.interface = {
		.class_handler = NULL,
		.custom_handler = msosv2_custom_handle_req,
		.vendor_handler = msosv2_vendor_handle_req,
	},
	.num_endpoints = ARRAY_SIZE(webusb_ep_data),
	.endpoint = webusb_ep_data
};
```

## src/webusb.h
```c
/*
 * SPDX-License-Identifier: Apache-2.0
 */

/**
 * @file
 * @brief WebUSB enabled custom class driver header file
 *
 * Header file for WebUSB enabled custom class driver
 */

#ifndef __WEBUSB_SERIAL_H__
#define __WEBUSB_SERIAL_H__

#include <zephyr/types.h>
#include <zephyr/net/buf.h>
#include "message_handler.h"

/**
 * @brief Initializes WebUSB component
 *
 */
void webusb_init(void);

/**
 * @brief Transmits a USB package
 *
 */
int webusb_transmit(struct net_buf *tx_net_buf);

/**
 * @brief Register message handler callback
 *
 * Function to register message handler callback for handling device messages
 *
 * @param [in] handlers Pointer to WebUSB message handler structure
 */
void webusb_register_message_handler(void (*cb)(struct webusb_message *msg_ptr,
						uint16_t msg_length));

#endif /* __WEBUSB_SERIAL_H__ */
```
